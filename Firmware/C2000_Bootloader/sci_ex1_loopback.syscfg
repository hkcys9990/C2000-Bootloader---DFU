/**
 * @cliArgs --device "F28003x" --package "100PZ" --part "F28003x_100PZ" --product "C2000WARE@4.01.00.00"
 * @versions {"tool":"1.14.0+2667"}
 */

/**
 * Import the modules used in this configuration.
 */
const sci  = scripting.addModule("/driverlib/sci.js", {}, false);
const sci1 = sci.addInstance();

/**
 * Write custom configuration values to the imported modules.
 */
sci1.$name       = "mySCI0";
sci1.baudRates   = 9600;
sci1.loopback    = true;
sci1.sci.$assign = "SCIA";

/**
 * Pinmux solution for unlocked pins/peripherals. This ensures that minor changes to the automatic solver in a future
 * version of the tool will not impact the pinmux you originally saw.  These lines can be completely deleted in order to
 * re-solve from scratch.
 */
sci1.sci.sci_rxPin.$suggestSolution = "ball.55";
sci1.sci.sci_txPin.$suggestSolution = "ball.54";
